## Documentation/devicetree/bindings/soc/qcom/qcom,sps-sic.yaml
```yaml
# SPDX-License-Identifier: GPL-2.0-only OR BSD-2-Clause
%YAML 1.2
---
$id: http://devicetree.org/schemas/soc/qcom/qcom,sps-sic.yaml#
$schema: http://devicetree.org/meta-schemas/core.yaml#

title: Qualcomm Smart Peripheral System Interrupt Controller

maintainers:
  - Dmitry Baryshkov <dmitry.baryshkov@oss.qualcomm.com>
  - Bjorn Andersson <andersson@kernel.org>

description:
  Smart Peripheral System (SPS) Interrupt Controller (SIC)

properties:
  compatible:
    items:
      - const: qcom,apq8064-sps-sic
      - const: syscon

  reg:
    items:
      - description: SPS SIC register block

required:
  - compatible
  - reg

unevaluatedProperties: false

examples:
  - |
    interrupt-controller@12100000 {
        compatible = "qcom,apq8064-sps-sic", "syscon";
        reg = <0x12100000 0x10000>;
    };
...
```

## Documentation/devicetree/bindings/thermal/qcom,qmi-tmd-device.yaml
```yaml
# SPDX-License-Identifier: (GPL-2.0 OR BSD-2-Clause)

%YAML 1.2
---
$id: "http://devicetree.org/schemas/thermal/qcom,qmi-tmd-device.yaml#"
$schema: "http://devicetree.org/meta-schemas/core.yaml#"

title: Qualcomm QMI based thermal mitigation (TMD) cooling devices.

maintainers:
  - Bhupesh Sharma <bhupesh.sharma@linaro.org>

description:
  Qualcomm QMI based TMD cooling device(s) are used for various
  mitigations for remote subsystem(s) including remote processor
  mitigation, rail voltage restriction etc.

properties:
  $nodename:
    const: qmi-tmd-devices

  compatible:
    items:
      - const: qcom,qmi-tmd-devices

  modem0:
    $ref: /schemas/thermal/qcom,tmd-device.yaml#

  adsp:
    $ref: /schemas/thermal/qcom,tmd-device.yaml#

  cdsp:
    $ref: /schemas/thermal/qcom,tmd-device.yaml#

  slpi:
    $ref: /schemas/thermal/qcom,tmd-device.yaml#

required:
  - compatible

unevaluatedProperties: false

examples:
  - |
    #include <dt-bindings/thermal/qcom,tmd.h>
    qmi-tmd-devices {
      compatible = "qcom,qmi-tmd-devices";

      modem0 {
        qcom,instance-id = <MODEM0_INSTANCE_ID>;

        modem0_pa: tmd-device0 {
          label = "pa";
          #cooling-cells = <2>;
        };

        modem0_proc: tmd-device1 {
          label = "modem";
          #cooling-cells = <2>;
        };

        modem0_current: tmd-device2 {
          label = "modem_current";
          #cooling-cells = <2>;
        };

        modem0_skin: tmd-device3 {
          label = "modem_skin";
          #cooling-cells = <2>;
        };

        modem0_vdd: tmd-device4 {
          label = "cpuv_restriction_cold";
          #cooling-cells = <2>;
        };
      };
    };
...
```

## Documentation/devicetree/bindings/thermal/qcom,tmd-device.yaml
```yaml
# SPDX-License-Identifier: (GPL-2.0-only OR BSD-2-Clause)

%YAML 1.2
---
$id: "http://devicetree.org/schemas/thermal/qcom,tmd-device.yaml#"
$schema: "http://devicetree.org/meta-schemas/core.yaml#"

title: Qualcomm thermal mitigation (TMD) cooling devices

maintainers:
  - Bhupesh Sharma <bhupesh.sharma@linaro.org>

description:
  Qualcomm thermal mitigation (TMD) cooling devices. Each child node
  represents one remote subsystem and each child of this subsystem in-turn
  represents separate cooling devices.

properties:
  $nodename:
    pattern: "^(modem|adsp|cdsp|slpi[0-9])?$"

  qcom,instance-id:
    $ref: /schemas/types.yaml#/definitions/uint32
    description:
      Remote subsystem QMI server instance id to be used for communicating with QMI.

patternProperties:
  "^tmd-device[0-9]?$":
    type: object
    description:
      Subnodes indicating tmd cooling device of a specific category.
    properties:
      label:
        maxItems: 1
        description: |
          Remote subsystem device identifier. Acceptable device names -
          "pa" -> for pa cooling device,
          "cpuv_restriction_cold" -> for vdd restriction,
          "cx_vdd_limit" -> for vdd limit,
          "modem" -> for processor passive cooling device,
          "modem_current" -> for current limiting device,
          "modem_bw" ->  for bus bandwidth limiting device,
          "cpr_cold" -> for cpr restriction.

      "#cooling-cells":
        const: 2

    required:
      - label
      - "#cooling-cells"

    additionalProperties: false

required:
  - qcom,instance-id

additionalProperties: false

examples:
  - |
    #include <dt-bindings/thermal/qcom,tmd.h>
    modem0 {
      qcom,instance-id = <MODEM0_INSTANCE_ID>;

      modem0_pa: tmd-device0 {
        label = "pa";
        #cooling-cells = <2>;
      };

      modem0_proc: tmd-device1 {
        label = "modem";
        #cooling-cells = <2>;
      };

      modem0_current: tmd-device2 {
        label = "modem_current";
        #cooling-cells = <2>;
      };

      modem0_skin: tmd-device3 {
        label = "modem_skin";
        #cooling-cells = <2>;
      };

      modem0_vdd: tmd-device4 {
        label = "cpuv_restriction_cold";
        #cooling-cells = <2>;
      };
    };

  - |
    #include <dt-bindings/thermal/qcom,tmd.h>
    adsp {
      qcom,instance-id = <ADSP_INSTANCE_ID>;

      adsp_vdd: tmd-device1 {
        label = "cpuv_restriction_cold";
        #cooling-cells = <2>;
      };
    };

  - |
    #include <dt-bindings/thermal/qcom,tmd.h>
    cdsp {
      qcom,instance-id = <CDSP_INSTANCE_ID>;

      cdsp_vdd: tmd-device1 {
        label = "cpuv_restriction_cold";
        #cooling-cells = <2>;
      };
    };

  - |
    #include <dt-bindings/thermal/qcom,tmd.h>
    slpi {
      qcom,instance-id = <SLPI_INSTANCE_ID>;

      slpi_vdd: tmd-device1 {
        label = "cpuv_restriction_cold";
        #cooling-cells = <2>;
      };
    };
```

## drivers/iommu/iommufd/Kconfig
```kconfig
# SPDX-License-Identifier: GPL-2.0-only
config IOMMUFD
	tristate "IOMMU Userspace API"
	select INTERVAL_TREE
	select INTERVAL_TREE_SPAN_ITER
	select IOMMU_API
	default n
	help
	  Provides /dev/iommu the user API to control the IOMMU subsystem as
	  it relates to managing IO page tables that point at user space memory.

	  If you don't know what to do here, say N.

if IOMMUFD
config IOMMUFD_VFIO_CONTAINER
	bool "IOMMUFD provides the VFIO container /dev/vfio/vfio"
	depends on VFIO && !VFIO_CONTAINER
	default VFIO && !VFIO_CONTAINER
	help
	  IOMMUFD will provide /dev/vfio/vfio instead of VFIO. This relies on
	  IOMMUFD providing compatibility emulation to give the same ioctls.
	  It provides an option to build a kernel with legacy VFIO components
	  removed.

	  Unless testing IOMMUFD say N here.

config IOMMUFD_TEST
	bool "IOMMU Userspace API Test support"
	depends on RUNTIME_TESTING_MENU
	depends on FAULT_INJECTION
	default n
	help
	  This is dangerous, do not enable unless running
	  tools/testing/selftests/iommu
endif
```

## drivers/power/pwrseq/Kconfig
```kconfig
menuconfig POWER_SEQ
	default y if OF
	bool "Hardware reset support for specific devices"
	help
	  Provides drivers that implements specific power sequences for chips,
	  using the generic power sequence management interface.

if POWER_SEQ

config POWER_SEQ_EMMC
	tristate "HW reset support for eMMC"
	default y
	depends on OF || COMPILE_TEST
	help
	  This selects Hardware reset support aka pwrseq-emmc for eMMC
	  devices. By default this option is set to y.

	  This driver can also be built as a module. If so, the module
	  will be called pwrseq_emmc.

config POWER_SEQ_SIMPLE
	tristate "Simple HW reset support for MMC"
	default y
	depends on OF || COMPILE_TEST
	help
	  This selects simple hardware reset support aka pwrseq-simple for MMC
	  devices. By default this option is set to y.

	  This driver can also be built as a module. If so, the module
	  will be called pwrseq_simple.

endif
```

## drivers/thermal/qcom/qmi_cooling/Kconfig
```kconfig
# SPDX-License-Identifier: GPL-2.0-only

config QCOM_QMI_COOLING
	tristate "Qualcomm QMI cooling drivers"
	depends on QCOM_RPROC_COMMON
	depends on ARCH_QCOM || COMPILE_TEST
	select QCOM_QMI_HELPERS
	help
	   This enables the remote subsystem cooling devices. These cooling
	   devices will be used by Qualcomm chipset to place various remote
	   subsystem mitigations like remote processor passive mitigation,
	   remote subsystem voltage restriction at low temperatures etc.
	   The QMI cooling device will interface with remote subsystem
	   using Qualcomm remoteproc interface.
```
