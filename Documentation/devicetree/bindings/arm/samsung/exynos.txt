## Documentation/devicetree/bindings/arm/samsung/exynos.txt
```
Samsung Exynos SoC Family Device Tree Bindings
---------------------------------------------------------------

Work in progress statement:

Following Device Tree files and bindings applying to Samsung Exynos SoCs and
boards are considered "unstable":

 - samsung,exynos5433* (all compatibles related to Exynos5433)
 - samsung,exynos7* (all compatibles related to Exynos7)
 - samsung,tm2-audio
 - samsung,mfc-v10
 - samsung,exynos*-mipi-dsi
 - samsung,exynos5-dp
 - samsung,exynos*-hdmi
 - samsung,exynos*-hdmiddc
 - samsung,exynos*-hdmiphy
 - samsung,exynos*-mixer
 - samsung,exynos*-fimd

Any Samsung Exynos device tree binding mentioned may change at any time. Be
sure to use a device tree binary and a kernel image generated from the same
source tree.

Please refer to Documentation/devicetree/bindings/ABI.txt for a definition of a
stable binding/ABI.
```

## Documentation/devicetree/bindings/crypto/fsl-vf610-crc.txt
```
Freescale/NXP Vybrid VF500/VF610 CRC HW accelerator

Required properties:
- compatible : Should be "fsl,vf610-crc"
- reg : Should contain register location and length.
- clocks : Should contain the clock driving the CRC block.
- clock-names : Should be set to "crc".

Example:

crc@40033000 {
	compatible = "fsl,vf610-crc";
	reg = <0x40033000 0x10>;
	clocks = <&clks VF610_CLK_CRC>;
	clock-names = "crc";
};
```

## Documentation/devicetree/bindings/display/msm/qcom,sfpb.yaml
```yaml
# SPDX-License-Identifier: GPL-2.0-only OR BSD-2-Clause
%YAML 1.2
---
$id: http://devicetree.org/schemas/display/msm/qcom,sfpb.yaml#
$schema: http://devicetree.org/meta-schemas/core.yaml#

title: Qualcomm MultiMedia SubSystem System FPB

maintainers:
  - Dmitry Baryshkov <dmitry.baryshkov@oss.qualcomm.com>
  - Rob Clark <robdclark@gmail.com>

description:
  The SFPB provides several registers controlling the multimedia attachment to
  the system busses.

properties:
  compatible:
    items:
      - const: qcom,apq8064-mmss-sfpb
      - const: syscon

  reg:
    items:
      - description: SFPB register block

required:
  - compatible
  - reg

unevaluatedProperties: false

examples:
  - |
    syscon@5700000 {
        compatible = "qcom,apq8064-mmss-sfpb", "syscon";
        reg = <0x5700000 0x70>;
    };
...
```

## Documentation/devicetree/bindings/display/panel/novatek,nt37801.yaml
```yaml
# SPDX-License-Identifier: GPL-2.0-only OR BSD-2-Clause
%YAML 1.2
---
$id: http://devicetree.org/schemas/display/panel/novatek,nt37801.yaml#
$schema: http://devicetree.org/meta-schemas/core.yaml#

title: Novatek NT37801 AMOLED DSI Panel

maintainers:
  - Neil Armstrong <neil.armstrong@linaro.org>

description:
  Naming is inconclusive and different sources claim this is either Novatek
  NT37801 or NT37810 AMOLED DSI Panel.

allOf:
  - $ref: panel-common.yaml#

properties:
  compatible:
    const: novatek,nt37801

  reg:
    maxItems: 1
    description: DSI virtual channel

  vddio-supply: true
  vci-supply: true
  vdd-supply: true
  port: true
  reset-gpios: true

required:
  - compatible
  - reg
  - vddio-supply
  - vci-supply
  - vdd-supply
  - reset-gpios
  - port

additionalProperties: false

examples:
  - |
    #include <dt-bindings/gpio/gpio.h>

    dsi {
        #address-cells = <1>;
        #size-cells = <0>;

        panel@0 {
            compatible = "visionox,vtdr6130";
            reg = <0>;

            vddio-supply = <&vreg_l12b_1p8>;
            vci-supply = <&vreg_l13b_3p0>;
            vdd-supply = <&vreg_l11b_1p2>;

            reset-gpios = <&tlmm 98 GPIO_ACTIVE_LOW>;

            port {
                endpoint {
                    remote-endpoint = <&dsi0_out>;
                };
            };
        };
    };
...
```

## Documentation/devicetree/bindings/examples/gpio-controller-and-hogs.yaml
```yaml
# SPDX-License-Identifier: (GPL-2.0-only OR BSD-2-Clause)
%YAML 1.2
---
$id: http://devicetree.org/schemas/examples/gpio-controller-and-hogs.yaml#
$schema: http://devicetree.org/meta-schemas/core.yaml#

title: An Example GPIO Controller with Hogs

maintainers:
  - Rob Herring <robh@kernel.org>
  - Krzysztof Kozlowski <krzk@kernel.org>
  - Conor Dooley <conor@kernel.org>

properties:
  compatible:
    const: test,gpio-controller-and-hogs

  gpio-controller: true

  "#gpio-cells":
    const: 2

  gpio-line-names:
    minItems: 1
    maxItems: 32

  gpio-ranges:
    minItems: 1
    maxItems: 16

  # Not every GPIO controller is an interrupt-controller
  interrupt-controller: true

  "#interrupt-cells":
    const: 2

patternProperties:
  "-hog(-[0-9]+)?$":
    type: object
    required:
      - gpio-hog

required:
  - compatible
  - interrupt-controller
  - "#interrupt-cells"
  - gpio-controller
  - "#gpio-cells"

additionalProperties: false

examples:
  - |
    #include <dt-bindings/gpio/gpio.h>
    #include <dt-bindings/interrupt-controller/arm-gic.h>

    gpio {
        compatible = "test,gpio-controller-and-hogs";

        gpio-controller;
        #gpio-cells = <2>;
        gpio-ranges = <&iomuxc 0 0 32>;
        interrupt-controller;
        #interrupt-cells = <2>;

        usb3-sata-sel-hog {
            gpio-hog;
            gpios = <4 GPIO_ACTIVE_HIGH>;
            line-name = "usb3_sata_sel";
            output-low;
        };
    };
```

## Documentation/devicetree/bindings/examples/multiple-variants-and-variable-lists.yaml
```yaml
# SPDX-License-Identifier: (GPL-2.0-only OR BSD-2-Clause)
%YAML 1.2
---
$id: http://devicetree.org/schemas/examples/multiple-variants-and-variable-lists.yaml#
$schema: http://devicetree.org/meta-schemas/core.yaml#

title: An Example Device with Multiple Variants and Variable Clock Inputs

maintainers:
  - Rob Herring <robh@kernel.org>
  - Krzysztof Kozlowski <krzk@kernel.org>
  - Conor Dooley <conor@kernel.org>

properties:
  compatible:
    enum:
      - test,variant-2-clocks
      - test,variant-3-clocks
      - test,variant-4-clocks

  # Same principles as for clocks apply also to all list-based properties, like
  # power-domains, reg, resets, etc.
  clocks:
    minItems: 2
    maxItems: 4

  # It is preferred that variants (devices) share as much as possible from
  # lists, e.g. the list has common part with 'minItems: X'.  Example shows
  # case when list cannot be constructed that way.
  clock-names:
    minItems: 2
    maxItems: 4

required:
  - compatible
  - clocks
  - clock-names

allOf:
  - if:
      properties:
        compatible:
          const: test,variant-2-clocks
    then:
      properties:
        clocks:
          maxItems: 2
        clock-names:
          items:
            - const: bus
            - const: core

  - if:
      properties:
        compatible:
          const: test,variant-3-clocks
    then:
      properties:
        clocks:
          minItems: 3
          maxItems: 3
        clock-names:
          items:
            - const: bus
            - const: ref
            - const: lane

  - if:
      properties:
        compatible:
          const: test,variant-4-clocks
    then:
      properties:
        clocks:
          minItems: 4
        clock-names:
          items:
            - const: bus
            - const: ref
            - const: tx_lane
            - const: rx_lane

additionalProperties: false

# Usually, if examples different by one property only one example is useful.
# For the purpose of the excercise all variants are described.
examples:
  - |
    device {
        compatible = "test,variant-2-clocks";

        clocks = <&cc 1>, <&cc 2>;
        clock-names = "bus", "core";
    };

  - |
    device {
        compatible = "test,variant-3-clocks";

        clocks = <&cc 1>, <&cc 2>, <&cc 3>;
        clock-names = "bus", "ref", "lane";
    };

  - |
    device {
        compatible = "test,variant-4-clocks";

        clocks = <&cc 1>, <&cc 2>, <&cc 3>, <&cc 4>;
        clock-names = "bus", "ref", "tx_lane", "rx_lane";
    };
```

## Documentation/devicetree/bindings/extcon/extcon-usb-gpio.yaml
```yaml
# SPDX-License-Identifier: (GPL-2.0-only OR BSD-2-Clause)
%YAML 1.2
---
$id: http://devicetree.org/schemas/extcon/extcon-usb-gpio.yaml#
$schema: http://devicetree.org/meta-schemas/core.yaml#

title: USB GPIO Extcon device

maintainers:
  - Alexander Stein <alexander.stein@ew.tq-group.com>

description:
  This is a virtual device used to generate USB cable states from the
  USB ID pin connected to a GPIO pin.
  Deprecated, use USB connector node instead.

deprecated: true

properties:
  compatible:
    const: linux,extcon-usb-gpio

  id-gpios:
    description: An input gpio for USB ID pin.
    maxItems: 1

  vbus-gpios:
    description: An input gpio for USB VBus pin, used to detect presence of
      VBUS 5V.
    maxItems: 1

required:
  - compatible

anyOf:
  - required:
      - id-gpios
  - required:
      - vbus-gpios

additionalProperties: false

examples:
  - |
    #include <dt-bindings/gpio/gpio.h>

    extcon-usb1 {
      compatible = "linux,extcon-usb-gpio";
      id-gpios = <&gpio6 1 GPIO_ACTIVE_HIGH>;
      vbus-gpios = <&gpio6 2 GPIO_ACTIVE_HIGH>;
    };
```

## Documentation/devicetree/bindings/gpio/gpio-common.yaml
```yaml
# SPDX-License-Identifier: (GPL-2.0-only OR BSD-2-Clause)
%YAML 1.2
---
$id: http://devicetree.org/schemas/gpio/gpio-common.yaml#
$schema: http://devicetree.org/meta-schemas/core.yaml#

title: Common GPIO controller properties

maintainers:
  - Krzysztof Kozlowski <krzk@kernel.org>
  - Linus Walleij <linus.walleij@linaro.org>

properties:
  nodename:
    pattern: "^(gpio-controller|gpio)(@[0-9a-f]+|-[0-9a-f]+)?$"

  '#gpio-cells': true
  gpio-controller: true
  gpio-ranges: true

  gpio-line-names:
    description: |
      Optionally, a GPIO controller may have a "gpio-line-names" property. This
      is an array of strings defining the names of the GPIO lines going out of
      the GPIO controller. This name should be the most meaningful producer
      name for the system, such as a rail name indicating the usage. Package
      names such as pin name are discouraged: such lines have opaque names
      (since they are by definition generic purpose) and such names are usually
      not very helpful.

      For example "MMC-CD", "Red LED Vdd" and "ethernet reset" are reasonable
      line names as they describe what the line is used for. "GPIO0" is not a
      good name to give to a GPIO line.

      Placeholders are discouraged: rather use the "" (blank string) if the use
      of the GPIO line is undefined in your design. The names are assigned
      starting from line offset 0 from left to right from the passed array. An
      incomplete array (where the number of passed named are less than ngpios)
      will still be used up until the last provided valid line index.

  gpio-reserved-ranges:
    description:
      Indicates the start and size of the GPIOs that can't be used.

  ngpios:
    description: |
      Optionally, a GPIO controller may have a "ngpios" property. This property
      indicates the number of in-use slots of available slots for GPIOs. The
      typical example is something like this: the hardware register is 32 bits
      wide, but only 18 of the bits have a physical counterpart. The driver is
      generally written so that all 32 bits can be used, but the IP block is
      reused in a lot of designs, some using all 32 bits, some using 18 and
      some using 12. In this case, setting "ngpios = <18>;" informs the driver
      that only the first 18 GPIOs, at local offset 0 .. 17, are in use.

      If these GPIOs do not happen to be the first N GPIOs at offset 0...N-1,
      an additional set of tuples is needed to specify which GPIOs are
      unusable, with the gpio-reserved-ranges binding.

patternProperties:
  "^(hog-[0-9]+|.+-hog(-[0-9]+)?)$":
    type: object
    description:
      The GPIO chip may contain GPIO hog definitions. GPIO hogging is a mechanism
      providing automatic GPIO request and configuration as part of the
      gpio-controller's driver probe function.
      Each GPIO hog definition is represented as a child node of the GPIO controller.

    properties:
      gpio-hog: true
      gpios: true
      input: true
      output-high: true
      output-low: true
      line-name:
        description:
          The GPIO label name. If not present the node name is used.

    required:
      - gpio-hog
      - gpios

    oneOf:
      - required:
          - input
      - required:
          - output-high
      - required:
          - output-low

    additionalProperties: false

required:
  - "#gpio-cells"
  - gpio-controller

examples:
  - |
    gpio-controller@15000000 {
        compatible = "foo";
        reg = <0x15000000 0x1000>;
        gpio-controller;
        #gpio-cells = <2>;
        ngpios = <18>;
        gpio-reserved-ranges = <0 4>, <12 2>;
        gpio-line-names = "MMC-CD", "MMC-WP", "VDD eth", "RST eth", "LED R",
                          "LED G", "LED B", "Col A", "Col B", "Col C", "Col D",
                          "Row A", "Row B", "Row C", "Row D", "NMI button",
                          "poweroff", "reset";
    };

  - |
    gpio-controller@1400 {
        compatible = "fsl,qe-pario-bank-a", "fsl,qe-pario-bank";
        reg = <0x1400 0x18>;
        gpio-controller;
        #gpio-cells = <2>;

        line-b-hog {
            gpio-hog;
            gpios = <6 0>;
            input;
            line-name = "foo-bar-gpio";
        };
    };
```
