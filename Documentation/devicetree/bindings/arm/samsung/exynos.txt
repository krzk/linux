## Documentation/devicetree/bindings/memory-controllers/atmel,ebi.yaml
```yaml
# SPDX-License-Identifier: (GPL-2.0-only OR BSD-2-Clause)
%YAML 1.2
---
$id: http://devicetree.org/schemas/memory-controllers/atmel,ebi.yaml#
$schema: http://devicetree.org/meta-schemas/core.yaml#

title: Atmel External Bus Interface (EBI)

maintainers:
  - Boris Brezillon <bbrezillon@kernel.org>
  - Krzysztof Kozlowski <krzk@kernel.org>

description:
  The External Bus Interface (EBI) controller is a bus where you can connect
  asynchronous (NAND, NOR, SRAM, ....) and synchronous memories (SDR/DDR
  SDRAMs).  The EBI provides a glue-less interface to asynchronous memories
  through the SMC (Static Memory Controller).

properties:
  $nodename:
    pattern: "^memory-controller@[0-9a-f]+$"

  compatible:
    enum:
      - atmel,at91sam9260-ebi
      - atmel,at91sam9261-ebi
      - atmel,at91sam9263-ebi0
      - atmel,at91sam9263-ebi1
      - atmel,at91sam9rl-ebi
      - atmel,at91sam9g45-ebi
      - atmel,at91sam9x5-ebi
      - atmel,sama5d3-ebi
      - microchip,sam9x60-ebi

  "#address-cells":
    const: 2

  "#size-cells":
    const: 1

  reg:
    maxItems: 8
    description:
      This property might contain several entries if the EBI
      memory range is not contiguous

  clocks:
    maxItems: 1

  ranges:
    minItems: 1

patternProperties:
  "@[0-3],[a-f0-9]+$":
    type: object
    description: |
      The Children device nodes are representing device connected to the EBI
      bus.

    properties:
      compatible: true

      reg:
        items:
          - items:
              - description: |
                  Chip-select ID, as in the parent range property.
                minimum: 0
                maximum: 2
              - description: |
                  Offset of the memory region requested by the device.
              - description: |
                  Length of the memory region requested by the device.

      atmel,smc-bus-width:
        descruption: width of the asynchronous device's data bus
        $ref: /schemas/types.yaml#/definitions/uint32
        enum: [8, 16, 32]
        default: 8
        
      atmel,smc-byte-access-type:
        description: see Atmel datasheet
        $ref: /schemas/types.yaml#/definitions/string
        enum:
          - write
          - select
        default: select
        
      atmel,smc-read-mode:
        description: see Atmel datasheet
        $ref: /schemas/types.yaml#/definitions/string
        enum:
          - nrd
          - ncs
        default: ncs

      atmel,smc-write-mode:
        description: see Atmel datasheet
        $ref: /schemas/types.yaml#/definitions/string
        enum:
          - nwe
          - ncs
        default: ncs
        
      atmel,smc-exnw-mode:
        description: see Atmel datasheet
        $ref: /schemas/types.yaml#/definitions/string
        enum:
          - disabled
          - frozen
          - ready
        default: disabled

      atmel,smc-page-mode:
        description: enable page mode if present with given page size
        $ref: /schemas/types.yaml#/definitions/uint32
        enum: [4, 8, 16, 32]

      atmel,smc-tdf-mode:
        description: |
          When set to "optimized" the data float time is optimized depending on
          the next device being accessed (next device setup time is subtracted
          to the current device data float time).
        $ref: /schemas/types.yaml#/definitions/string
        enum:
          - normal
          - optimized
        default: normal

      atmel,smc-ncs-rd-setup-ns:
        description: timing in nanoseconds, see Atmel datasheet
        $ref: /schemas/types.yaml#/definitions/uint32

      atmel,smc-nrd-setup-ns:
        description: timing in nanoseconds, see Atmel datasheet
        $ref: /schemas/types.yaml#/definitions/uint32

      atmel,smc-ncs-wr-setup-ns:
        description: timing in nanoseconds, see Atmel datasheet
        $ref: /schemas/types.yaml#/definitions/uint32

      atmel,smc-nwe-setup-ns:
        description: timing in nanoseconds, see Atmel datasheet
        $ref: /schemas/types.yaml#/definitions/uint32
          
      atmel,smc-ncs-rd-pulse-ns:
        description: timing in nanoseconds, see Atmel datasheet
        $ref: /schemas/types.yaml#/definitions/uint32

      atmel,smc-nrd-pulse-ns:
        description: timing in nanoseconds, see Atmel datasheet
        $ref: /schemas/types.yaml#/definitions/uint32

      atmel,smc-ncs-wr-pulse-ns:
        description: timing in nanoseconds, see Atmel datasheet
        $ref: /schemas/types.yaml#/definitions/uint32

      atmel,smc-nwe-pulse-ns:
        description: timing in nanoseconds, see Atmel datasheet
        $ref: /schemas/types.yaml#/definitions/uint32

      atmel,smc-nwe-cycle-ns:
        description: timing in nanoseconds, see Atmel datasheet
        $ref: /schemas/types.yaml#/definitions/uint32

      atmel,smc-nrd-cycle-ns:
        description: timing in nanoseconds, see Atmel datasheet
        $ref: /schemas/types.yaml#/definitions/uint32

      atmel,smc-tdf-ns:
        description: timing in nanoseconds, see Atmel datasheet
        $ref: /schemas/types.yaml#/definitions/uint32

    required:
      - reg

    dependencies:
      atmel,smc-bus-width: ['atmel,smc-ncs-rd-setup-ns', 'atmel,smc-nrd-setup-ns',
                            'atmel,smc-ncs-wr-setup-ns', 'atmel,smc-nwe-setup-ns',
                            'atmel,smc-ncs-rd-pulse-ns', 'atmel,smc-nrd-pulse-ns',
                            'atmel,smc-ncs-wr-pulse-ns', 'atmel,smc-nwe-pulse-ns'
                            'atmel,smc-nwe-cycle-ns', 'atmel,smc-nrd-cycle-ns',
                            'atmel,smc-tdf-ns']

required:
  - compatible
  - reg
  - clocks
  - "#address-cells"
  - "#size-cells"
  - ranges

additionalProperties: false

examples:
  - |
    memory-controller@10000000 {
        compatible = "atmel,sama5d3-ebi";
        #address-cells = <2>;
        #size-cells = <1>;
        atmel,smc = <&hsmc>;
        atmel,matrix = <&matrix>;
        reg = <0x10000000 0x10000000>,
              <0x40000000 0x30000000>;
        ranges = <0x0 0x0 0x10000000 0x10000000
                  0x1 0x0 0x40000000 0x10000000
                  0x2 0x0 0x50000000 0x10000000
                  0x3 0x0 0x60000000 0x10000000>;
        clocks = <&mck>;
        
        pinctrl-names = "default";
        pinctrl-0 = <&pinctrl_ebi_addr>;
        
        flash@0,0 {
            compatible = "cfi-flash";
            #address-cells = <1>;
            #size-cells = <1>;
            reg = <0x0 0x0 0x1000000>;
            bank-width = <2>;
            
            atmel,smc-read-mode = "nrd";
            atmel,smc-write-mode = "nwe";
            atmel,smc-bus-width = <16>;
            atmel,smc-ncs-rd-setup-ns = <0>;
            atmel,smc-ncs-wr-setup-ns = <0>;
            atmel,smc-nwe-setup-ns = <8>;
            atmel,smc-nrd-setup-ns = <16>;
            atmel,smc-ncs-rd-pulse-ns = <84>;
            atmel,smc-ncs-wr-pulse-ns = <84>;
            atmel,smc-nrd-pulse-ns = <76>;
            atmel,smc-nwe-pulse-ns = <76>;
            atmel,smc-nrd-cycle-ns = <107>;
            atmel,smc-nwe-cycle-ns = <84>;
            atmel,smc-tdf-ns = <16>;
        };
    };
```

## Documentation/devicetree/bindings/memory-controllers/memory-controller.yaml
```yaml
# SPDX-License-Identifier: (GPL-2.0-only OR BSD-2-Clause)
%YAML 1.2
---
$id: http://devicetree.org/schemas/memory-controllers/memory-controller.yaml#
$schema: http://devicetree.org/meta-schemas/core.yaml#

title: Memory Controller for External Bus/Devices generic bindings

maintainers:
  - Krzysztof Kozlowski <krzk@kernel.org>

description: |
  Memory Controller for an External Bus and Devices represents a block
  is a generic term which includes several different use cases. One of them - the controller for

  like configuring RAM parameters, configu

  The NAND controller should be represented with its own DT node, and
  all NAND chips attached to this controller should be defined as
  children nodes of the NAND controller. This representation should be
  enforced even for simple controllers supporting only one chip.

  The ECC strength and ECC step size properties define the user
  desires in terms of correction capability of a controller. Together,
  they request the ECC engine to correct {strength} bit errors per
  {size} bytes.

  The interpretation of these parameters is implementation-defined, so
  not all implementations must support all possible
  combinations. However, implementations are encouraged to further
  specify the value(s) they support.

properties:
  $nodename:
    pattern: "^memory-controller(@.*)?"

  "#address-cells":
    const: 2

  "#size-cells":
    const: 1

  ranges: true

patternProperties:
  "^.*@[0-3],[a-f0-9]+$":
    type: object
    properties:
      reg: true

    required:
      - reg

required:
  - "#address-cells"
  - "#size-cells"

additionalProperties: true

examples:
  - |
    memory-controller@12570000 {
        #address-cells = <2>;
        #size-cells = <1>;
        ranges = <0 0 0x04000000 0x20000   // Bank0
                  1 0 0x05000000 0x20000   // Bank1
                  2 0 0x06000000 0x20000   // Bank2
                  3 0 0x07000000 0x20000>; // Bank3

        compatible = "samsung,exynos4210-srom";
        reg = <0x12570000 0x14>;

        ethernet@3,0 {
            compatible = "smsc,lan9115";
            reg = <3 0 0x10000>;     // Bank 3, offset = 0
            phy-mode = "mii";
            interrupt-parent = <&gpx0>;
            interrupts = <5 8>;
            reg-io-width = <2>;
            smsc,irq-push-pull;
            smsc,force-internal-phy;

            samsung,srom-page-mode;
            samsung,srom-timing = <9 12 1 9 1 1>;
        };
    };
```

## Documentation/devicetree/bindings/power/pwrseq/pwrseq-simple.txt
```
* The simple power sequence provider

The purpose of the simple power sequence provider is to supports a set of
common properties between various SOC designs. It thus enables us to use the
same provider for several SOC designs.

The driver supports two types of bindings:
1. Property for any node
   Required properties:
   - power-sequence

2. Separate node (not recommended for new users)
   Required properties:
   - compatible : contains "mmc-pwrseq-simple".


Optional properties:
- reset-gpios : contains a list of GPIO specifiers. The reset GPIOs are asserted
	at initialization and prior we start the power up procedure of the card.
	They will be de-asserted right after the power has been provided to the
	card.
- clocks : Must contain an entry for the entry in clock-names.
  See ../clocks/clock-bindings.txt for details.
- clock-names : Must include the following entry:
  "ext_clock" (External clock provided to the card).
- *-supply : If supplies are provided, the driver will enable and disable
             them during power sequence.

Example:

	sdhci0_pwrseq {
		compatible = "mmc-pwrseq-simple";
		reset-gpios = <&gpio1 12 GPIO_ACTIVE_LOW>;
		clocks = <&clk_32768_ck>;
		clock-names = "ext_clock";
	}

	usb3503@08 {
		compatible = "smsc,usb3503";
		reg = <0x08>;

		intn-gpios = <&gpx3 0 GPIO_ACTIVE_HIGH>;
		connect-gpios = <&gpx3 4 GPIO_ACTIVE_HIGH>;
		reset-gpios = <&gpx3 5 GPIO_ACTIVE_HIGH>;
		initial-mode = <1>;

		power-sequence;
		vdd-supply = <&buck8_reg>;
	};
```

## Documentation/devicetree/bindings/regulator/maxim,max77802.yaml
```yaml
# SPDX-License-Identifier: GPL-2.0-only OR BSD-2-Clause
%YAML 1.2
---
$id: http://devicetree.org/schemas/regulator/maxim,max77802.yaml#
$schema: http://devicetree.org/meta-schemas/core.yaml#

title: Maxim MAX77802 Power Management IC regulators

maintainers:
  - Javier Martinez Canillas <javier@dowhile0.org>
  - Krzysztof Kozlowski <krzysztof.kozlowski@canonical.com>

description: |
  This is a part of device tree bindings for Maxim MAX77802 Power Management
  Integrated Circuit (PMIC).

  The Maxim MAX77802 provides 10 high-efficiency Bucks and 32 Low-DropOut (LDO)
  regulators.

  See also Documentation/devicetree/bindings/mfd/maxim,max77686.yaml for
  additional information and example.

patternProperties:
  # 32 LDOs (numbering not continous, missing: LDO17, LDO22 and LDO31)
  "^LDO([1-9]|1[0-5]|1[7-9]|2[01]|2[3-9]|30|3[2-5])$":
    type: object
    $ref: regulator.yaml#
    description: |
      Properties for single LDO regulator.

    properties:
      regulator-name: true

    required:
      - regulator-name

    unevaluatedProperties: false

  # 10 bucks
  "^BUCK([1-9]|10)$":
    type: object
    $ref: regulator.yaml#
    description: |
      Properties for single BUCK regulator.

    properties:
      regulator-name: true

    required:
      - regulator-name

    unevaluatedProperties: false

additionalProperties: false
```

## Documentation/devicetree/bindings/remoteproc/qcom,qcs404-pas.yaml
```yaml
# SPDX-License-Identifier: GPL-2.0 OR BSD-2-Clause
%YAML 1.2
---
$id: http://devicetree.org/schemas/remoteproc/qcom,qcs404-pas.yaml#
$schema: http://devicetree.org/meta-schemas/core.yaml#

title: Qualcomm QCS404 Peripheral Authentication Service

maintainers:
  - Manivannan Sadhasivam <manivannan.sadhasivam@linaro.org>

description:
  Qualcomm QCS404 SoC Peripheral Authentication Service loads and boots
  firmware on the Qualcomm DSP Hexagon cores.

properties:
  compatible:
    enum:
      - qcom,qcs404-adsp-pas
      - qcom,qcs404-cdsp-pas
      - qcom,qcs404-wcss-pas

  reg:
    maxItems: 1

  interrupts:
    maxItems: 5

  interrupt-names:
    maxItems: 5

  power-domains: false
  power-domain-names: false
  smd-edge: false

required:
  - compatible
  - reg

allOf:
  - $ref: /schemas/remoteproc/qcom,pas-common.yaml#
  - if:
      properties:
        compatible:
          enum:
            - qcom,qcs404-adsp-pas
            - qcom,qcs404-wcss-pas
    then:
      properties:
        clocks:
          items:
            - description: XO clock
        clock-names:
          items:
            - const: xo

  - if:
      properties:
        compatible:
          enum:
            - qcom,qcs404-cdsp-pas
    then:
      properties:
        clocks:
          items:
            - description: XO clock
            - description: SWAY clock
            - description: TBU clock
            - description: BIMC clock
            - description: AHB AON clock
            - description: Q6SS SLAVE clock
            - description: Q6SS MASTER clock
            - description: Q6 AXIM clock
        clock-names:
          items:
            - const: xo
            - const: sway
            - const: tbu
            - const: bimc
            - const: ahb_aon
            - const: q6ss_slave
            - const: q6ss_master
            - const: q6_axim

unevaluatedProperties: false

examples:
  - |
    #include <dt-bindings/interrupt-controller/arm-gic.h>
    #include <dt-bindings/interrupt-controller/irq.h>

    remoteproc@c700000 {
        compatible = "qcom,qcs404-adsp-pas";
        reg = <0x0c700000 0x4040>;

        clocks = <&xo_board>;
        clock-names = "xo";

        interrupts-extended = <&intc GIC_SPI 293 IRQ_TYPE_EDGE_RISING>,
                              <&adsp_smp2p_in 0 IRQ_TYPE_EDGE_RISING>,
                              <&adsp_smp2p_in 1 IRQ_TYPE_EDGE_RISING>,
                              <&adsp_smp2p_in 2 IRQ_TYPE_EDGE_RISING>,
                              <&adsp_smp2p_in 3 IRQ_TYPE_EDGE_RISING>;
        interrupt-names = "wdog", "fatal", "ready",
                          "handover", "stop-ack";

        memory-region = <&adsp_fw_mem>;

        qcom,smem-states = <&adsp_smp2p_out 0>;
        qcom,smem-state-names = "stop";

        glink-edge {
            interrupts = <GIC_SPI 289 IRQ_TYPE_EDGE_RISING>;

            qcom,remote-pid = <2>;
            mboxes = <&apcs_glb 8>;

            label = "adsp";
        };
    };
```
