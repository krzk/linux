## Documentation/devicetree/bindings/phy/qcom,eliza-hdmi-phy.yaml
```yaml
# SPDX-License-Identifier: (GPL-2.0-only OR BSD-2-Clause)
%YAML 1.2
---

$id: http://devicetree.org/schemas/phy/qcom,eliza-hdmi-phy.yaml#
$schema: http://devicetree.org/meta-schemas/core.yaml#

title: Qualcomm Eliza SoC HDMI phy (Synopsys)

maintainers:
  - Rob Clark <robdclark@gmail.com>
  - Krzysztof Kozlowski <krzysztof.kozlowski@oss.qualcomm.com>

properties:
  compatible:
    enum:
      - qcom,eliza-hdmi-phy

  reg:
    maxItems: 1

  '#clock-cells':
    const: 0

  clocks:
    maxItems: 3

  clock-names:
    items:
      - const: iface
      - const: ref
      - const: xo

  power-domains:
    maxItems: 1

  '#phy-cells':
    const: 0

required:
  - compatible
  - reg
  - clocks
  - clock-names
  - '#clock-cells'
  - '#phy-cells'

additionalProperties: false

examples:
  - |
    #include <dt-bindings/clock/qcom,eliza-dispcc.h>
    #include <dt-bindings/clock/qcom,eliza-tcsr.h>
    #include <dt-bindings/power/qcom,rpmhpd.h>

    phy@aea1000 {
        compatible = "qcom,eliza-hdmi-phy";
        reg = <0x0aea1000 0x1000>;

        #clock-cells = <0>;
        clocks = <&dispcc DISP_CC_MDSS_AHB_CLK>,
                 <&tcsr TCSR_HDMI_CLKREF_EN>,
                 <&bi_tcxo_div2>;
        clock-names = "iface",
                      "ref",
                      "xo";

        #phy-cells = <0>;

        power-domains = <&rpmhpd RPMHPD_CX>;
    };
```
